## meta-luv/conf/distro/luv.conf
```bitbake
DISTRO_NAME = "Linux UEFI Validation Distribution"
DISTRO_VERSION = "1.0"

TCLIBCAPPEND = ""

PREFERRED_PROVIDER_virtual/kernel = "linux-yocto-efi-test"
PREFERRED_VERSION_kexec-tools = "2.0.7"

LAYER_CONF_VERSION ?= "6"

PACKAGE_EXCLUDE = "busybox"
```
